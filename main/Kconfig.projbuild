## main/Kconfig.projbuild
```kconfig
menu "Wifi conf"

	config ESP_WIFI_SSID_AP
		string "WiFi SSID"
		default "ESP32"
		help
			SSID (network name) to station.

	config ESP_WIFI_PASSWORD_AP
		string "WiFi Password"
		default "testowehaslo"
		help
			WiFi password (WPA or WPA2) in the station mode.
			
	config ESP_WIFI_SSID_ST
		string "WiFi SSID (station mode)"
		default "SiecImperialna1"
		help
			SSID (network name) for the example to connect to.
		
	config ESP_WIFI_PASSWORD_ST
		string "WiFi Password (station mode"
		default "1mPer1UMm"
	help
			WiFi password (WPA or WPA2) in the station mode.
		
	config ESP_WIFI_CHANNEL
		int "WiFi Channel"
		range 1 13
		default 1
		help
			WiFi channel (network channel) for the example to use.
	
	config ESP_MAX_STA_CONN
		int "Maximal STA connections"
		default 4
		help
			Max number of the STA connects to AP.
		
endmenu
```
